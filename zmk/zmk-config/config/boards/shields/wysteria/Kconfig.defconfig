## zmk/zmk-config/config/boards/shields/wysteria/Kconfig.defconfig
```kconfig
if SHIELD_JWE_WYST_LEFT

config ZMK_KEYBOARD_NAME
    default "Wysteria"

config ZMK_SPLIT_ROLE_CENTRAL
    default y

endif

if SHIELD_JWE_WYST_LEFT || SHIELD_JWE_WYST_RIGHT

config ZMK_SPLIT
    default y

endif
```

## zmk/zmk-config/config/boards/shields/wysteria/Kconfig.shield
```kconfig
config SHIELD_JWE_WYST_LEFT
    def_bool $(shields_list_contains,wysteria_left)

config SHIELD_JWE_WYST_RIGHT
    def_bool $(shields_list_contains,wysteria_right)
```
