#include "wysteria.dtsi"

&nice_view_spi {
        cs-gpios = <&pro_micro 0 GPIO_ACTIVE_HIGH>;
};

&default_transform { // The matrix transform for this board is 5 columns over because the left half is 5 columns wide according to the matrix.
    col-offset = <6>;
};

&kscan0 {
    col-gpios
        = <&pro_micro 21 GPIO_ACTIVE_HIGH>
        , <&pro_micro 14 GPIO_ACTIVE_HIGH>
        , <&pro_micro 15 GPIO_ACTIVE_HIGH>
        , <&pro_micro 18 GPIO_ACTIVE_HIGH>
        , <&pro_micro 19 GPIO_ACTIVE_HIGH>
        , <&pro_micro 20 GPIO_ACTIVE_HIGH>
        ;
};

&right_encoder {
    status = "okay";
};
